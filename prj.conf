## CMakeLists.txt
```
# SPDX-License-Identifier: Apache-2.0

# Default board
set(BOARD esp32c3_devkitm)

cmake_minimum_required(VERSION 3.20.0)

find_package(Zephyr REQUIRED HINTS $ENV{ZEPHYR_BASE})
project(wifi)

FILE(GLOB app_sources src/*.c)
target_sources(app PRIVATE ${app_sources})
zephyr_include_directories(config)

# Generate a git hash that's used as part of the software_version, eg
# 1.0.0+12345678. Permit overriding at command line for CI builds.
if (NOT DEFINED ZEPHYR_MEMFAULT_EXAMPLE_GIT_SHA1)
  EXECUTE_PROCESS(
    WORKING_DIRECTORY ${CMAKE_CURRENT_SOURCE_DIR}
    COMMAND git rev-parse --short HEAD
    RESULT_VARIABLE commit_sha1
    OUTPUT_VARIABLE ZEPHYR_MEMFAULT_EXAMPLE_GIT_SHA1
    OUTPUT_STRIP_TRAILING_WHITESPACE
    COMMAND_ERROR_IS_FATAL ANY
  )
endif()

zephyr_compile_definitions(
  ZEPHYR_MEMFAULT_EXAMPLE_GIT_SHA1=\"${ZEPHYR_MEMFAULT_EXAMPLE_GIT_SHA1}\"
)
```

## Kconfig
```
# Application Kconfig file
#
# This is loaded when building this directory with west.
menu "Memfault Example Application Configuration"

config MEMFAULT_PROJECT_KEY
    string "Memfault Project Key"
    help
      The Memfault Project Key to use for this example application.
      This can be found by logging into https://app.memfault.com, clicking on
      the settings icon in the top right corner, and selecting "Projects".

config MEMFAULT_EXAMPLE_SOFTWARE_VERSION
    string "Software Version"
    default "1.0.0"
    help
      The software version to report to Memfault.

endmenu

source "Kconfig.zephyr"
```

## west.yml
```
manifest:
  projects:
    - name: zephyr
      url: https://github.com/zephyrproject-rtos/zephyr
      revision: v3.7.0
      import:
        # Limit the Zephyr modules to the required set
        name-allowlist:
          - hal_espressif
          - mbedtls
          - mcuboot

    - name: memfault-firmware-sdk
      url: https://github.com/memfault/memfault-firmware-sdk
      path: modules/lib/memfault-firmware-sdk
      revision: 1.16.0
```

## prj.conf
```kconfig
CONFIG_EARLY_CONSOLE=y
CONFIG_SHELL=y

CONFIG_NETWORKING=y
# Use the testing RNG. This is NOT suitable for production use. Some devices do
# not have a built-in RNG in Zephyr upstream, so this is convenient for testing.
# CONFIG_TEST_RANDOM_GENERATOR=y

CONFIG_NET_TX_STACK_SIZE=2048
CONFIG_NET_RX_STACK_SIZE=2048

CONFIG_NET_PKT_RX_COUNT=10
CONFIG_NET_PKT_TX_COUNT=10
CONFIG_NET_BUF_RX_COUNT=32
CONFIG_NET_BUF_TX_COUNT=32
CONFIG_NET_BUF_DATA_SIZE=256
CONFIG_NET_DEBUG_NET_PKT_ALLOC=y
CONFIG_MEM_SLAB_TRACE_MAX_UTILIZATION=y

# Network protocols
CONFIG_NET_DHCPV4=y

CONFIG_NET_IPV4=y
CONFIG_NET_IPV6=n

CONFIG_NET_TCP=y

CONFIG_NET_LOG=y
CONFIG_INIT_STACKS=y

CONFIG_NET_SHELL=y

CONFIG_NET_STATISTICS=y
CONFIG_NET_STATISTICS_PERIODIC_OUTPUT=n

CONFIG_WIFI=y
CONFIG_WIFI_LOG_LEVEL_ERR=y
CONFIG_NET_L2_WIFI_SHELL=y

# Memfault configuration
CONFIG_MEMFAULT=y
CONFIG_MEMFAULT_LOGGING_ENABLE=y
CONFIG_MEMFAULT_HTTP_ENABLE=y
CONFIG_MEMFAULT_TLS_CERTS_USE_DER=y
CONFIG_MEMFAULT_HTTP_PERIODIC_UPLOAD=y

# Additional network configuration for Memfault features
CONFIG_DNS_RESOLVER=y
CONFIG_NET_SOCKETS=y
CONFIG_TLS_CREDENTIALS=y
CONFIG_NET_SOCKETS_SOCKOPT_TLS=y
CONFIG_NET_STATISTICS=y
CONFIG_NET_STATISTICS_USER_API=y

# MbedTLS config
CONFIG_MBEDTLS_SERVER_NAME_INDICATION=y
CONFIG_MBEDTLS_ENABLE_HEAP=y
CONFIG_MBEDTLS_HEAP_SIZE=30000
CONFIG_MBEDTLS_SSL_MAX_CONTENT_LEN=4096
CONFIG_MBEDTLS_MEMORY_DEBUG=y
CONFIG_MBEDTLS_SHELL=y

# More verbose Memfault component logs
CONFIG_MEMFAULT_LOG_LEVEL_DBG=y

# Don't log printk() statements, they're meant for raw output to the console.
CONFIG_LOG_PRINTK=n

CONFIG_LOG_MODE_IMMEDIATE=y

# Disable these temporarily, for debugging.
CONFIG_MEMFAULT_COREDUMP_COLLECT_DATA_REGIONS=n
CONFIG_MEMFAULT_COREDUMP_COLLECT_KERNEL_REGION=n
CONFIG_MEMFAULT_COREDUMP_COLLECT_TASKS_REGIONS=n

# Memfault's http client needs a small amount of heap. Zephyr requires a minimum
# heap size for the applied configuration, so select that here to prevent a
# build time message
CONFIG_HEAP_MEM_POOL_SIZE=51200
CONFIG_SYS_HEAP_RUNTIME_STATS=y
CONFIG_SHELL_STACK_SIZE=4096
CONFIG_SYSTEM_WORKQUEUE_STACK_SIZE=2048

# hwinfo is used for a unique device id
CONFIG_HWINFO=y

CONFIG_ASSERT=y

# Enable MCUboot
CONFIG_BOOTLOADER_MCUBOOT=y
CONFIG_MCUBOOT_SHELL=y
CONFIG_MCUBOOT_IMG_MANAGER=y
CONFIG_IMG_MANAGER=y
CONFIG_FLASH=y
CONFIG_FLASH_PAGE_LAYOUT=y
CONFIG_FLASH_MAP=y
CONFIG_STREAM_FLASH=y

# For cpu_temp metric
CONFIG_SENSOR=y
CONFIG_ADC=y
```

## src/main.c
```c
//! @file

// clang-format off
#include "memfault/ports/zephyr/include_compatibility.h"

#include MEMFAULT_ZEPHYR_INCLUDE(kernel.h)
#include MEMFAULT_ZEPHYR_INCLUDE(logging/log.h)
#include <string.h>

#include "memfault/components.h"
#include "memfault/ports/zephyr/http.h"
// clang-format on

LOG_MODULE_REGISTER(mflt_app, LOG_LEVEL_DBG);

MEMFAULT_STATIC_ASSERT(
  sizeof(CONFIG_MEMFAULT_PROJECT_KEY) > 1,
  "No Memfault Project Key Set! Please set CONFIG_MEMFAULT_PROJECT_KEY in prj.conf");

sMfltHttpClientConfig g_mflt_http_client_config = {
  .api_key = CONFIG_MEMFAULT_PROJECT_KEY,
};

void memfault_platform_get_device_info(sMemfaultDeviceInfo *info) {
  *info = (sMemfaultDeviceInfo){
    .device_serial = "DEMOSERIAL",
    .software_type = "zephyr-app",
    .software_version =
      CONFIG_MEMFAULT_EXAMPLE_SOFTWARE_VERSION "+" ZEPHYR_MEMFAULT_EXAMPLE_GIT_SHA1,
    .hardware_version = CONFIG_BOARD,
  };
}

int main(void) {
  LOG_INF("Memfault Demo App! Board %s\n", CONFIG_BOARD);

  printk("\n" MEMFAULT_BANNER_COLORIZED);

  memfault_device_info_dump();
  memfault_zephyr_port_install_root_certs();

  return 0;
}
```

## src/memfault_device_info.c
```c
#include "memfault/components.h"

void memfault_platform_get_device_info(sMemfaultDeviceInfo *info) {
  *info = (sMemfaultDeviceInfo){
      .device_serial = "DEMOSERIAL",
      .software_type = "zephyr-app",
      .software_version = "0.0.1" ZEPHYR_MEMFAULT_EXAMPLE_GIT_SHA1,
      .hardware_version = CONFIG_BOARD,
  };
}
```
